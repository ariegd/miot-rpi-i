## src/lab1/main/Kconfig.projbuild
```kconfig
menu "Lab1 Configuración"

    config HELLO_TASK_DELAY
        int "Tiempo de espera de hello_task (ms)"
        default 2000
        help
            Define el tiempo en milisegundos que espera la tarea hello_task.

    config WIFI_TASK_DELAY
        int "Tiempo de espera de wifi_info_task (ms)"
        default 3000
        help
            Define el tiempo en milisegundos que espera la tarea wifi_info_task.

endmenu
```

## src/labF/gattc_wifi/components/gattc_comp/Kconfig.projbuild
```kconfig
menu "GATT-CLIENT Configuration"
       config DEVICE_NAME_GATT
           string "Nombre del dispositivo BLE"
           default "ESP_GATTS_EJ-1"
           help
                Nombre que aparecerá en el escaneo BLE. Máximo 20 caracteres recomendados.

        config REMOTE_DEVICE_ADDRESS
            string "Remote BLE Device Address (e.g., 34:85:18:02:70:4E)"
            default ""
            help
                La dirección Bluetooth MAC del dispositivo que se quiera conectar.
                Formato: XX:XX:XX:XX:XX:XX

        config  BLE_SCAN_INTERVAL_MS
            int "BLE scan interval (ms)"
            default 1000
            range 3 10240
            help
              Intervalo de escaneo BLE en milisegundos (mínimo 3 ms, máximo 10240 ms)

        config  BLE_SCAN_WINDOW_MS
            int "BLE scan window (ms)"
            default 100
            range 3 10240
            help
              Ventana de escaneo BLE en milisegundos (mínimo 3 ms, máximo 10240 ms)

    config EXAMPLE_DUMP_ADV_DATA_AND_SCAN_RESP
        bool "Dump whole adv data and scan response data in example"
        default n

    config EXAMPLE_CI_ID
        int "example id for CI test"
        default 0
        help
            This config the example id for CI test. Only for internal used.

    config EXAMPLE_CI_PIPELINE_ID
        int "The pipeline id for CI test"
        default 0
        help
            This config the pipeline id for CI test. Only for internal used.

    config EXAMPLE_INIT_DEINIT_LOOP
        bool "Perform init deinit of bluedroid host in a loop"
        default n
        help
            This config perform host init deinit loop for CI test. Only for internal used
endmenu
```

## src/labF/gatts_touch/components/gatts_comp/Kconfig.projbuild
```kconfig
menu "GATT-SERVER Configuration"

   config DEVICE_NAME_GATT
       string "Nombre del dispositivo BLE"
       default "ESP_GATTS_EJ-1"
       help
            Nombre que aparecerá en el escaneo BLE. Máximo 20 caracteres recomendados.
            
endmenu
```

## src/labF/gatts_touch/components/touch_pad_comp/Kconfig.projbuild
```kconfig
menu "TOUCH-PAD Configuration"

   config TOUCH_PAD_NUMBER
        int "Numero de Touch Pad (GPIO)"
        range 0 9
        default 2
        help
            Selecciona el numero del sensor touch (p.e. 2 para GPIO2).

    config TOUCH_THRESH_FACTOR
        int "Factor de Umbral (%)"
        range 0 100
        default 80
        help
            Porcentaje del valor de referencia (baseline) para disparar la deteccion.

    config TIME_THRESHOLD_MS
        int "Tiempo de activacion requerido (ms)"
        range 0 10000
        default 1500
        help
            Milisegundos que el sensor debe estar presionado para enviar la alerta.
            
endmenu
```

## src/scan/main/Kconfig.projbuild
```kconfig
menu "Example Configuration"
	menu "WiFi Known Networks :)"
		config WIFI_KNOWN_NETWORKS_NUM
		    int "Number of known WiFi networks"
		    range 1 3
		    default 3

		config WIFI_KNOWN_SSID_1
		    string "SSID for network 1"
		    default "SSID_LABORATORIO"

		config WIFI_KNOWN_PASS_1
		    string "Password for network 1"
		    default "PASSWORD_LAB"

		config WIFI_KNOWN_PRI_1
		    int "Priority for network 1 (1=highest)"
		    default 1

		config WIFI_KNOWN_SSID_2
		    string "SSID for network 2"
		    default "SSID_MOVIL"

		config WIFI_KNOWN_PASS_2
		    string "Password for network 2"
		    default "PASSWORD_MOVIL"

		config WIFI_KNOWN_PRI_2
		    int "Priority for network 2"
		    default 2

		config WIFI_KNOWN_SSID_3
		    string "SSID for network 3"
		    default "SSID_DOMICILIO"

		config WIFI_KNOWN_PASS_3
		    string "Password for network 3"
		    default "PASSWORD_CASA"

		config WIFI_KNOWN_PRI_3
		    int "Priority for network 3"
		    default 3
	endmenu
	
    config EXAMPLE_SCAN_LIST_SIZE
        int "Max size of scan list"
        range 0 20
        default 10
        help
            The size of array that will be used to retrieve the list of access points.

    config EXAMPLE_USE_SCAN_CHANNEL_BITMAP
        bool "Scan only non overlapping channels using Channel bitmap"
        default 0
        help
            Enable this to scan only the non overlapping channels i.e 1,6,11 by mentioning a channel bitmap
            in scan config. If you wish to scan a different set of specific channels, please edit the channel_list
            array in scan.c. Channels for a 2.4 ghz network range should range from 1-14.
endmenu
```
